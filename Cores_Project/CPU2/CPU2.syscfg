/**
 * @cliArgs --device "F2838x" --package "176pin" --part "F2838x_176pin" --context "CPU2" --product "C2000WARE@5.00.00.00"
 * @versions {"tool":"1.19.0+3426"}
 */

/**
 * Import the modules used in this configuration.
 */
const device_support = scripting.addModule("/driverlib/device_support.js");
const ipc            = scripting.addModule("/driverlib/ipc.js");
const memcfg         = scripting.addModule("/driverlib/memcfg.js");
const CMD            = scripting.addModule("/utilities/cmd_tool/cmd_syscfg/source/CMD");
const CMD1           = CMD.addInstance();

/**
 * Write custom configuration values to the imported modules.
 */
ipc.ipcRegisterFlag = ["IPC_FLAG31"];
ipc.flagHandler31   = "IPC_SYNC";

CMD.activateCMD = true;
CMD.activeCMD   = "CMD_Config";

CMD1.sectionMemory_binit                 = ["FLASH4"];
CMD1.sectionAlignEnable_binit            = true;
CMD1.sectionMemory_stack                 = ["RAMM1"];
CMD1.sectionMemory_bss                   = ["RAMLS5"];
CMD1.sectionMemory_data                  = ["RAMLS5"];
CMD1.sectionMemory_sysmem                = ["RAMLS5"];
CMD1.$name                               = "CMD_Config";
CMD1.sectionRun_text                     = ["RAMLS1","RAMLS2","RAMLS3","RAMLS4"];
CMD1.sectionMemory_ramfunc               = ["FLASH3"];
CMD1.sectionAlignEnable_ramfunc          = true;
CMD1.sectionMemory_codestart             = "0x080000";
CMD1.sectionMemory_text                  = ["FLASH1","FLASH2","FLASH3","FLASH4"];
CMD1.sectionAlignEnable_text             = true;
CMD1.sectionMemory_cinit                 = ["FLASH4"];
CMD1.sectionAlignEnable_cinit            = true;
CMD1.sectionMemory_switch                = ["FLASH1"];
CMD1.sectionAlignEnable_switch           = true;
CMD1.sectionMemory_init_array            = ["FLASH1"];
CMD1.sectionAlignEnable_init_array       = true;
CMD1.sectionMemory_const                 = ["FLASH5"];
CMD1.sectionAlignEnable_const            = true;
CMD1.sectionMemory_ovly                  = ["FLASH1"];
CMD1.sectionAlignEnable_ovly             = true;
CMD1.sectionRunFromDifferentAddr_ramfunc = true;
CMD1.sectionRun_ramfunc                  = ["RAMLS0"];
CMD1.sectionSymbols_ramfunc              = ["loadEnd","loadSize","loadStart","runEnd","runSize","runStart"];
CMD1.sectionBinit_ramfunc                = false;
